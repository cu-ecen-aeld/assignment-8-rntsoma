## base_external/package/ldd-assignments/Config.in
```kconfig
config BR2_PACKAGE_LDD_ASSIGNMENTS
	bool "ldd-assignments"
	depends on BR2_LINUX_KERNEL
	help
	  Includes the LDD code.
	  Used to understand buildroot external trees and package builds.
```
